/*
 * Copyright (c) 2020 The ZMK Contributors
 *
 * SPDX-License-Identifier: MIT
 */

#include "ergolily.dtsi"

&default_transform {
    col-offset = <7>;
};

&kscan0 {
    col-gpios
        = <&gpio0 10 GPIO_ACTIVE_HIGH>  // P0.16 - outer
        , <&gpio1 0  GPIO_ACTIVE_HIGH>  // P0.06 - pinkie
        , <&gpio0 11  GPIO_ACTIVE_HIGH>  // P0.07 - ring
        , <&gpio1 4  GPIO_ACTIVE_HIGH>  // P0.08 - middle / thumb1
        , <&gpio1 6  GPIO_ACTIVE_HIGH>  // P0.09 - index / thumb2
        , <&gpio0 9 GPIO_ACTIVE_HIGH>  // P0.10 - inner / thumb3
        , <&gpio1 13 GPIO_ACTIVE_HIGH>  // P0.14 - innest / thumb4
        ;

    row-gpios
        = <&gpio0 8 (GPIO_ACTIVE_HIGH | GPIO_PULL_DOWN)>  // P0.00 - lower
        , <&gpio0 6 (GPIO_ACTIVE_HIGH | GPIO_PULL_DOWN)>  // P0.01 - home
        , <&gpio0 17 (GPIO_ACTIVE_HIGH | GPIO_PULL_DOWN)>  // P0.02 - upper
        , <&gpio0 20 (GPIO_ACTIVE_HIGH | GPIO_PULL_DOWN)>  // P0.03 - num
        , <&gpio0 22 (GPIO_ACTIVE_HIGH | GPIO_PULL_DOWN)>  // P0.04 - thumb row
        ;
};
