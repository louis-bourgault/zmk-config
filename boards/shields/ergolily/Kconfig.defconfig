## boards/shields/ergolily/Kconfig.defconfig
```kconfig
# Copyright (c) 2020 The ZMK Contributors
# SPDX-License-Identifier: MIT

if SHIELD_ERGOLILY_LEFT

config ZMK_KEYBOARD_NAME
	default "ErgoLily"

config ZMK_SPLIT_ROLE_CENTRAL
	default y

endif

if SHIELD_ERGOLILY_LEFT || SHIELD_ERGOLILY_RIGHT

config ZMK_SPLIT
	default y

endif
```

## boards/shields/ergolily/Kconfig.shield
```kconfig
# Copyright (c) 2020 The ZMK Contributors
# SPDX-License-Identifier: MIT

config SHIELD_ERGOLILY_LEFT
	def_bool $(shields_list_contains,ergolily_left)

config SHIELD_ERGOLILY_RIGHT
	def_bool $(shields_list_contains,ergolily_right)
```
